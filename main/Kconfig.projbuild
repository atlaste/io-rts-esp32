## main/Kconfig.projbuild
```kconfig
menu "IO RTS Project Configuration"

    orsource "$IDF_PATH/examples/common_components/env_caps/$IDF_TARGET/Kconfig.env_caps"

    config CMD_LINE_MANAGEMENT_DEFAULT_PWD
        string "Command line password"
        default "io-rts-esp32"
        help
            Up to 32 characters. Set to empty if you don't want to protect command line access by password (unsecure).

    choice CONNECTIVITY_CHOOSE_LAYER
        prompt "Choose between Wifi and Ethernet"
        default CONNECTIVITY_CHOICE_WIFI

        config CONNECTIVITY_CHOICE_WIFI
            bool "Wifi"
            depends on SOC_WIFI_SUPPORTED
        
        config CONNECTIVITY_CHOICE_ETH
            bool "Ethernet (W5500 SPI module)"
            select ETH_USE_SPI_ETHERNET
    endchoice

    choice IP_LAYER_CHOOSE_MODE
        prompt "Choose between DHCP and static IP"
        default CONNECTIVITY_CHOICE_DHCP

        config CONNECTIVITY_CHOICE_DHCP
            bool "DHCP"
        
        config CONNECTIVITY_CHOICE_STATIC
            bool "Static IP"
    endchoice

    config IP_LAYER_HOSTNAME
        string "Hostname"
        default "io-rts-esp32"
        help
            Set hostname.

    config SNTP_TIME_SERVER
        string "SNTP server name"
        default "pool.ntp.org"
        help
            Hostname of the SNTP server.

    menu "Static IP Configuration"
        visible if CONNECTIVITY_CHOICE_STATIC

        config IP_LAYER_STATIC_IP_ADDR
        string "Static IP address"
        default "192.168.1.253"
        help
            Set static IP address.

        config IP_LAYER_STATIC_NETMASK_ADDR
            string "Static netmask address"
            default "255.255.255.0"
            help
                Set static netmask address.

        config IP_LAYER_STATIC_GW_ADDR
            string "Static gateway address"
            default "192.168.1.1"
            help
                Set static gateway address.

        config IP_LAYER_STATIC_DNS_SERVER_MAIN
            string "Main DNS server address"
            default "192.168.1.1"
            help
                Set main DNS server address.

        config IP_LAYER_STATIC_DNS_SERVER_BACKUP
            string "Backup DNS server address"
            default "192.168.1.1"
            help
                Set backup DNS server address. It can be same with the main DNS server address.
    endmenu

    menu "Wifi Configuration"
        depends on CONNECTIVITY_CHOICE_WIFI

        config ESP_WIFI_SSID
            string "WiFi SSID"
            default "myssid"
            help
                SSID (network name) to connect to.

        config ESP_WIFI_PASSWORD
            string "WiFi Password"
            default "mypassword"
            help
                WiFi password (WPA or WPA2) to use.

        choice ESP_WIFI_SAE_MODE
            prompt "WPA3 SAE mode selection"
            default ESP_STATION_WPA3_SAE_PWE_BOTH
            help
                Select mode for SAE as Hunt and Peck, H2E or both.
            config ESP_STATION_WPA3_SAE_PWE_HUNT_AND_PECK
                bool "HUNT AND PECK"
            config ESP_STATION_WPA3_SAE_PWE_HASH_TO_ELEMENT
                bool "H2E"
                depends on ESP_WIFI_ENABLE_SAE_H2E
            config ESP_STATION_WPA3_SAE_PWE_BOTH
                bool "BOTH"
                depends on ESP_WIFI_ENABLE_SAE_H2E
        endchoice

        config ESP_WIFI_PW_ID
            string "Password identifier for SAE H2E"
            depends on  ESP_STATION_WPA3_SAE_PWE_HASH_TO_ELEMENT || ESP_STATION_WPA3_SAE_PWE_BOTH
            default ""

        choice ESP_WIFI_SCAN_AUTH_MODE_THRESHOLD
            prompt "WiFi Scan auth mode threshold"
            default ESP_WIFI_AUTH_WPA2_WPA3_PSK
            help
                The weakest authmode to accept in the scan mode.
                This value defaults to ESP_WIFI_AUTH_WPA2_PSK in case password is present and ESP_WIFI_AUTH_OPEN is used.
                Please select ESP_WIFI_AUTH_WEP/ESP_WIFI_AUTH_WPA_PSK in case AP is operating in WEP/WPA mode.

            config ESP_WIFI_AUTH_OPEN
                bool "OPEN (unsecure)"
            config ESP_WIFI_AUTH_WEP
                bool "WEP (unsecure)"
            config ESP_WIFI_AUTH_WPA_PSK
                bool "WPA PSK (unsecure)"
            config ESP_WIFI_AUTH_WPA_WPA2_PSK
                bool "WPA/WPA2 PSK (unsecure)"
            config ESP_WIFI_AUTH_WPA2_PSK
                bool "WPA2 PSK"
            config ESP_WIFI_AUTH_WAPI_PSK
                bool "WAPI PSK"
            config ESP_WIFI_AUTH_WPA2_WPA3_PSK
                bool "WPA2/WPA3 PSK"
            config ESP_WIFI_AUTH_WPA3_PSK
                bool "WPA3 PSK"
        endchoice
    endmenu

    menu "Ethernet Configuration"
        depends on CONNECTIVITY_CHOICE_ETH

        choice ETHERNET_SPI_HOST
            prompt "Choose SPI_HOST to use for Ethernet module"
            default ETHERNET_SPI_HOST2
            help
                You can use same SPI_HOST for Ethernet and radio modules and share SCLK, MOSI and MISO pins.

            config ETHERNET_SPI_HOST2
                bool "SPI_HOST2"
            
            config ETHERNET_SPI_HOST3
                bool "SPI_HOST3"
                depends on SOC_SPI_PERIPH_NUM > 2
        endchoice

        config ETHERNET_SPI_CLOCK_MHZ
            int "SPI clock speed (MHz) for Ethernet module"
            range 5 80
            default 40
            help
                Set the clock speed (MHz) of SPI interface. Note: some modules crash at speed greater than 60, increase carefully!

        config ETHERNET_SPI_CS_GPIO
            int "SPI CS GPIO number for SPI Ethernet module"
            range ENV_GPIO_RANGE_MIN ENV_GPIO_IN_RANGE_MAX
            default 14
            help
                Set the GPIO number used by SPI CS, i.e. Chip Select associated with the SPI Eth module).

        config ETHERNET_SPI_INT0_GPIO
            int "Interrupt GPIO number SPI Ethernet module"
            range ENV_GPIO_RANGE_MIN ENV_GPIO_IN_RANGE_MAX
            default 15
            help
                Set the GPIO number used by the SPI Ethernet module interrupt line.

        config ETHERNET_SPI_PHY_RST_GPIO
            int "PHY Reset GPIO number of SPI Ethernet Module"
            range ENV_GPIO_RANGE_MIN ENV_GPIO_OUT_RANGE_MAX
            default 16
            help
                Set the GPIO number used to reset PHY chip on the SPI Ethernet module.
    endmenu

    menu "IO Configuration"

        config IOHOMECONTROL_LOGGING_ENABLED
            bool "Enable logging in IO-HomeControl layer"
            default y

        config IOHOMECONTROL_PASSIVE_MODE
            bool "Passive only (not allowed to emit)"
            default y

        config IOHOMECONTROL_DEFAULT_KEY
            string "IO System key (16 bytes)"
            default "00112233445566778899AABBCCDDEEFF"
            help
                Default system key if not changed by configuration later (16 bytes)
        
        config IOHOMECONTROL_DEFAULT_NODEID
            string "IO Node ID (3 bytes)"
            default "112233"
            help
                Default Node ID if not changed by configuration later (3 bytes)

    config IOHOMECONTROL_DEFAULT_TX_POWER
        int "TX Power (dBm)"
        range 0 22
        default 20
        help
            Default Tx power in dBm. Valid range is 0-20 for SX1276 (PA_BOOST), 0-22 for SX1262.

    choice IOHOMECONTROL_RADIO_CHIP
        prompt "Radio chip"
        default IOHOMECONTROL_RADIO_SX1276
        help
            Pick the radio module connected to the ESP32. Both chips operate in 2-FSK at 868 MHz, the SX1276 is
            preferred because it natively supports the IO-Homecontrol packet format. The SX1262 driver emulates
            the IO-Home framing in software (fixed-length receive + software CRC-CCITT) so it should be wire-
            compatible, but is less battle-tested.

        config IOHOMECONTROL_RADIO_SX1276
            bool "Semtech SX1276 / SX1278"

        config IOHOMECONTROL_RADIO_SX1262
            bool "Semtech SX1261 / SX1262 / SX1268"
    endchoice

    choice IOHOMECONTROL_SX1276_SPI_HOST
        prompt "Choose SPI_HOST to use"
        default IOHOMECONTROL_SX1276_SPI_HOST2
        help
            You can use same SPI_HOST for Ethernet and radio modules and share SCLK, MOSI and MISO pins.
            (this setting applies to both SX1276 and SX1262 radio modules)

        config IOHOMECONTROL_SX1276_SPI_HOST2
            bool "SPI_HOST2"
        
        config IOHOMECONTROL_SX1276_SPI_HOST3
            bool "SPI_HOST3"
            depends on SOC_SPI_PERIPH_NUM > 2
    endchoice

    menu "SX1276 / SX1278 Pin Configuration"
        depends on IOHOMECONTROL_RADIO_SX1276

        config IOHOMECONTROL_SX1276_SPI_CS
            int "SPI CS GPIO Num"
            range ENV_GPIO_RANGE_MIN ENV_GPIO_OUT_RANGE_MAX
            default 7
            help
                GPIO number for SPI CS pin connected to SX1276 radio module.

        config IOHOMECONTROL_SX1276_RST
            int "RST GPIO Num"
            range ENV_GPIO_RANGE_MIN ENV_GPIO_OUT_RANGE_MAX
            default 8
            help
                GPIO number for RST pin connected to SX1276 radio module.

        config IOHOMECONTROL_SX1276_DIO0
            int "DIO0 GPIO Num"
            range ENV_GPIO_RANGE_MIN ENV_GPIO_OUT_RANGE_MAX
            default 9
            help
                GPIO number for DIO0 pin connected to SX1276 radio module.

        config IOHOMECONTROL_SX1276_DIO4
            int "DIO4 GPIO Num"
            range -1 ENV_GPIO_OUT_RANGE_MAX
            default 10
            help
                GPIO number for DIO4 pin connected to SX1276 radio module. Set -1 if not connected on your board.
    endmenu

    menu "SX1262 / SX1261 / SX1268 Pin Configuration"
        depends on IOHOMECONTROL_RADIO_SX1262

        config IOHOMECONTROL_SX1262_SPI_CS
            int "SPI CS / NSS GPIO Num"
            range ENV_GPIO_RANGE_MIN ENV_GPIO_OUT_RANGE_MAX
            default 7
            help
                GPIO number for SPI CS (NSS) pin connected to the SX1262 radio module.

        config IOHOMECONTROL_SX1262_RST
            int "RST GPIO Num"
            range ENV_GPIO_RANGE_MIN ENV_GPIO_OUT_RANGE_MAX
            default 8
            help
                GPIO number for RESET pin connected to the SX1262 radio module (active low).

        config IOHOMECONTROL_SX1262_BUSY
            int "BUSY GPIO Num"
            range ENV_GPIO_RANGE_MIN ENV_GPIO_IN_RANGE_MAX
            default 13
            help
                GPIO number for BUSY pin (input) connected to the SX1262 radio module.

        config IOHOMECONTROL_SX1262_DIO1
            int "DIO1 GPIO Num"
            range ENV_GPIO_RANGE_MIN ENV_GPIO_IN_RANGE_MAX
            default 14
            help
                GPIO number for DIO1 pin (input, IRQ) connected to the SX1262 radio module.

        config IOHOMECONTROL_SX1262_USE_DIO2_RF_SWITCH
            bool "Use DIO2 as antenna switch control"
            default y
            help
                Enable when the radio module wires DIO2 to the antenna RF switch (very common on
                Lilygo / Heltec / Ebyte SX1262 modules). Disable if DIO2 is unused on your board.

        config IOHOMECONTROL_SX1262_USE_TCXO
            bool "Module has TCXO controlled by DIO3"
            default n
            help
                Enable if the SX1262 module is equipped with a TCXO whose enable line is wired to
                DIO3 (Heltec V3, Lilygo T3-S3 SX1262, EBytE E22-900M22S, ...).

        config IOHOMECONTROL_SX1262_TCXO_VOLTAGE_MV
            int "TCXO control voltage (mV)"
            depends on IOHOMECONTROL_SX1262_USE_TCXO
            range 1600 3300
            default 3300
            help
                Voltage applied by DIO3 to power the TCXO. Common values are 1800 or 3300 mV.
                Heltec V3 modules use 1800 mV. The DFRobot ESP32-S3 LoRaWAN board (Beetle) and
                the Semtech reference designs use 3300 mV. When in doubt try 3300 mV first; an
                undervolted TCXO can appear to start (no XOSC_START_ERR) but produce a degraded
                clock that breaks GFSK sync detection.

        config IOHOMECONTROL_SX1262_USE_RXEN
            bool "External RX_EN GPIO drives the antenna switch RX path"
            default n
            help
                Enable when the antenna RF switch RX path is gated by an ESP32 GPIO instead of (or
                in addition to) DIO2. Common on the DFRobot ESP32-S3 LoRaWAN board where DIO2
                drives TX but a separate "LORA_RXEN" pin enables RX.

        config IOHOMECONTROL_SX1262_RXEN
            int "RX_EN GPIO Num"
            depends on IOHOMECONTROL_SX1262_USE_RXEN
            range ENV_GPIO_RANGE_MIN ENV_GPIO_OUT_RANGE_MAX
            default 42
            help
                GPIO number wired to the antenna RF switch RX_EN pin. Driven HIGH while receiving,
                LOW otherwise. (DFRobot ESP32-S3 LoRaWAN: GPIO 42)

        config IOHOMECONTROL_SX1262_USE_TXEN
            bool "External TX_EN GPIO drives the antenna switch TX path"
            default n
            help
                Enable when the antenna RF switch TX path is gated by an ESP32 GPIO. Most modules
                use DIO2 for this, so leave this disabled unless your schematic shows a dedicated
                TX_EN line going to the ESP32.

        config IOHOMECONTROL_SX1262_DIAG_SNIFFER
            bool "[DEBUG] 868 MHz GFSK sniffer mode (no preamble + 1-byte sync, big captures)"
            default n
            help
                Turn the SX1262 into a wide GFSK sniffer. Disables preamble detection entirely,
                programs a 1-byte sync (0xFF - the first non-preamble-like byte of the IO-Home
                sync 55 FF 33, also common in Somfy IO bursts) and captures up to 240 bytes per
                trigger. Re-arms continuously. Each RX_DONE is dumped as a hex chunk with
                timestamp + RSSI + frequency so the bytes can be post-processed off-line to
                find IO-Homecontrol, Somfy IO, evohome, Itho Daalderop, ... patterns regardless
                of byte alignment. Skips the IO-Homecontrol CRC decode (everything is captured
                raw). Expect frequent low-RSSI false triggers from noise; they are harmless and
                easy to filter by RSSI in post-processing. Disable in production.

        config IOHOMECONTROL_SX1262_DIAG_SNIFFER_RSSI_GATE_DBM
            int "[DEBUG] Sniffer RSSI gate (dBm, captures weaker than this are silently dropped)"
            depends on IOHOMECONTROL_SX1262_DIAG_SNIFFER
            range -130 0
            default -85
            help
                In sniffer mode the chip will fire RX_DONE on pure noise (~10-30 times per second)
                because we force a 1-byte sync match. Each capture is 240 bytes which costs ~70 ms
                of UART time at 115200 baud and would saturate the console + starve other tasks
                of the radio mutex. This threshold suppresses the hex dump (and the matching
                "RX_DONE: ..." header line) when the reported RSSI is below it. Real IO-Home /
                Somfy IO / evohome traffic typically arrives well above -85 dBm; lower this if
                you are listening to a far-away transmitter, raise it if you only care about
                strong local frames. Set to -130 to log everything.

        config IOHOMECONTROL_SX1262_DIAG_SNIFFER_HOP_MS
            int "[DEBUG] Sniffer dwell time per channel (ms, 0 = pin to channel 2)"
            depends on IOHOMECONTROL_SX1262_DIAG_SNIFFER
            range 0 60000
            default 1000
            help
                In sniffer mode the IO-Homecontrol stack still rotates between the three 868 MHz
                channels (868.25 / 868.95 / 869.85 MHz). The default IO-Home hop period of 2.7 ms
                is way too aggressive for continuous 240-byte captures and causes the radio mutex
                to be hammered, which in turn causes "SetFrequency - No mutex available!" spam
                and eventually a stuck RX state. Use 0 to disable hopping entirely (the radio
                stays on whatever channel IoHomeControl initialised - 868.95 MHz). Use 1000 ms
                or more for slow, predictable rotation that gives the sniffer plenty of time to
                capture multiple bursts on each channel.

        config IOHOMECONTROL_SX1262_TXEN
            int "TX_EN GPIO Num"
            depends on IOHOMECONTROL_SX1262_USE_TXEN
            range ENV_GPIO_RANGE_MIN ENV_GPIO_OUT_RANGE_MAX
            default 36
            help
                GPIO number wired to the antenna RF switch TX_EN pin. Driven HIGH while
                transmitting, LOW otherwise.
    endmenu
endmenu

    menu "MQTT Client configuration"
        config MQTT_CLIENT_ENABLE
            bool "Enable MQTT client"
            default y

        config MQTT_BROKER_ADDRESS
            string "MQTT Broker address"
            default "192.168.1.203"
            help
                MQTT broker address.
        
        config MQTT_BROKER_PORT
            int "MQTT Broker port"
            range 1 65535
            default 1883
            help
                MQTT broker listening port.
        
        config MQTT_CLIENT_ID
            string "MQTT Client ID"
            default "io-rts-esp32"
            help
                MQTT Client ID must be unique to connect to broker. It is also used as an identifier for Discovery message

        config MQTT_CLIENT_USERNAME
            string "MQTT Client username"
            default "mqtt_user"
            help
                MQTT Client username to connect to broker.

        config MQTT_CLIENT_PASSWORD
            string "MQTT Client password"
            default "mqtt_password"
            help
                MQTT Client password to connect to broker.

        config MQTT_CLIENT_TLS_ENABLED
            bool "Enable TLS to connect to broker"
            default n

        config MQTT_BROKER_CERTIFICATE
            string "MQTT broker certificate"
            default "-"
            help
                MQTT broker certificate (content of .pem file without --- BEGIN CERTIFICATE --- and ---END CERTIFICATE ---).

        config MQTT_TOPIC_PREFIX
            string "MQTT topic prefix"
            default "io-rts"
            help
                Prefix added before all MQTT topics except discovery.
        
        config MQTT_DISCOVERY_PREFIX
            string "MQTT discovery prefix"
            default "homeassistant/device/io-rts"
            help
                Prefix added before discovery topic. Discovery topic will be <MQTT_DISCOVERY_PREFIX>/config
    endmenu

    menu "SPI_HOST2 Configuration"
        depends on ETHERNET_SPI_HOST2 || IOHOMECONTROL_SX1276_SPI_HOST2

        config SPI_HOST2_SCK
            int "SPI SCK GPIO Num"
            range ENV_GPIO_RANGE_MIN ENV_GPIO_OUT_RANGE_MAX
            default 5
            help
                GPIO number for SPI SCK pin connected to SPI_HOST2.

        config SPI_HOST2_MOSI
            int "SPI MOSI GPIO Num"
            range ENV_GPIO_RANGE_MIN ENV_GPIO_OUT_RANGE_MAX
            default 6
            help
                GPIO number for SPI MOSI pin connected to SPI_HOST2.

        config SPI_HOST2_MISO
            int "SPI MISO GPIO Num"
            range ENV_GPIO_RANGE_MIN ENV_GPIO_OUT_RANGE_MAX
            default 3
            help
                GPIO number for SPI MISO pin connected to SPI_HOST2.

    endmenu

    menu "SPI_HOST3 Configuration"
        depends on ETHERNET_SPI_HOST3 || IOHOMECONTROL_SX1276_SPI_HOST3
        
        config SPI_HOST3_SCK
            int "SPI SCK GPIO Num"
            range ENV_GPIO_RANGE_MIN ENV_GPIO_OUT_RANGE_MAX
            default 11
            help
                GPIO number for SPI SCK pin connected to SPI_HOST3.

        config SPI_HOST3_MOSI
            int "SPI MOSI GPIO Num"
            range ENV_GPIO_RANGE_MIN ENV_GPIO_OUT_RANGE_MAX
            default 12
            help
                GPIO number for SPI MOSI pin connected to SPI_HOST3.

        config SPI_HOST3_MISO
            int "SPI MISO GPIO Num"
            range ENV_GPIO_RANGE_MIN ENV_GPIO_OUT_RANGE_MAX
            default 13
            help
                GPIO number for SPI MISO pin connected to SPI_HOST3.

    endmenu

endmenu
```
